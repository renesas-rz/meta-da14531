## conf/layer.conf
```bitbake
# We have a conf and classes directory, add to BBPATH
BBPATH .= ":${LAYERDIR}"

# We have recipes-* directories, add to BBFILES
BBFILES += "${LAYERDIR}/recipes-*/*/*.bb \
            ${LAYERDIR}/recipes-*/*/*.bbappend"

BBFILE_COLLECTIONS += "meta-da14531"
BBFILE_PATTERN_meta-da14531 = "^${LAYERDIR}/"
BBFILE_PRIORITY_meta-da14531 = "6"

LAYERDEPENDS_meta-da14531 = "core"
LAYERSERIES_COMPAT_meta-da14531 = "dunfell"
```
